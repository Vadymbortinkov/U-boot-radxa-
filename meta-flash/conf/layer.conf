## meta-flash/conf/layer.conf
```bitbake
# We have a conf and classes directory, add to BBPATH
BBPATH .= ":${LAYERDIR}"

# We have recipes-* directories, add to BBFILES
BBFILES += "${LAYERDIR}/recipes-*/*/*.bb \
            ${LAYERDIR}/recipes-*/*/*.bbappend"

BBFILE_COLLECTIONS += "meta-flash"
BBFILE_PATTERN_meta-flash = "^${LAYERDIR}/"
BBFILE_PRIORITY_meta-flash = "6"

LAYERDEPENDS_meta-flash = "core"
LAYERSERIES_COMPAT_meta-flash = "nanbield"
```
